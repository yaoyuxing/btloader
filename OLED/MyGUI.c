
#include "sys.h"
#include "delay.h"  
#include "oled.h"
#include "ChineseCharacter.h"
#include "MyGUI.h"
#include "string.h"
#include "ble_update.h"
#include "bootloader.h"

//图标隔开的竖线 
#define		X_VerticalLineInterval	2//到前图标的间隔
#define		X_VerticalLineWidth		2//线的宽度
/*上框位置定义*/
#define		X_START_HEAD  0//写起始位置的X坐标退位长度
#define		Y_START_HEAD  2//写起始位置的Y坐标下移动长度
//4G信号强度
#define		X_SignalStrengthIocnStart	X_START_HEAD //4G信号图标开始位置
#define		Y_SignalStrengthIocnStart	Y_START_HEAD //4G信号图标开始位置
#define		SignalStrengthIocnSize		12 //4G信号图标尺寸
#define		X_SignalStrengthIocnEnd		X_SignalStrengthIocnStart+SignalStrengthIocnSize //4G信号图标结束位置
#define		X_SignalStrengthCahrStart  	(X_SignalStrengthIocnEnd+4) //4G信号汉字开始位置“移动”
#define		X_SignalStrengthCahrEnd  		(X_SignalStrengthCahrStart+ChCh_4GSignalNUM*12+8) //4G信号汉字开始位置“移动”

//#define		SignalStrengthEnd   (X_SignalStrengthCahrEnd+X_START_HEAD) //4G信号结束显示的位置

//蓝牙显示位置定义
#define		BleWorkStatusStart	(X_SignalStrengthCahrEnd+8) //蓝牙状态显示开始位置
#define		X_BleWorkStatusStartIocnSize	(12) //蓝牙状态显示图标尺寸

#define		BleWorkStatusCahrStart  	(BleWorkStatusStart+X_BleWorkStatusStartIocnSize+2) //汉字开始位置
#define		BleWorkStatusEnd	(BleWorkStatusStart+X_BleWorkStatusStartIocnSize+12*(ChCh_BleConnectedNUM)+8) //蓝牙状态显示结束位置

//电池位置定义
#define		X_BatteryPowerStart (BleWorkStatusEnd+8)		//电池图标显示X坐标的开始位置
#define		Y_BatteryPowerStart	(Y_START_HEAD)		//电池图标显示y坐标的开始位置
#define		X_BatteryPowerIocnSize	(12) 				//电池图标显示图标尺寸
#define		X_BatteryPowerEnd 	(X_BatteryPowerStart+X_BatteryPowerIocnSize)		//电池图标显示X坐标的结束位置
#define		X_BatteryPower_VerticalLine_End 	(X_BatteryPowerEnd+X_VerticalLineWidth+X_VerticalLineInterval)		//电池图标竖线结束位置

/*
框位置定义
4条横y坐标定义
*/

#define OUTER_FRAME_Y_1 0
#define OUTER_FRAME_Y_2 15
#define OUTER_FRAME_Y_3 48
#define OUTER_FRAME_Y_4 63

#define OUTER_FRAME_X_1 0
#define OUTER_FRAME_X_2 127
/*
显示字符图标大小
*/
#define CHARACTER_ICON_SIZE  12

void  GUI_4GSignalStrengthChar(void);

static void GUI_VerticalLine(u8 x);
//电池电量  power共10个档位  (0到9)
void  GUI_BatteryPower(u8 power)
{
	u8 y=0,x=0;
	u8 x_start=0;
	x_start=X_BatteryPowerStart+1;
	OLED_ShowChineseString(X_BatteryPowerStart,Y_BatteryPowerStart,ChCh_BatteryIconNum,CHARACTER_ICON_SIZE,1 ,(int)ChCh_BatteryIcon);
	for(x=x_start;x<x_start+power;x++)
	{
		for(y=Y_BatteryPowerStart+3;y<Y_BatteryPowerStart+9;y++) 
		{
				OLED_DrawPoint(x,y,1);
		}	
	}
//	GUI_VerticalLine(X_BatteryPowerEnd+2);
	
}

/*
屏幕线框
*/
void  GUI_Wireframe(void)
{
	u8 num=0;
	for(num=0;num<128;num++)
	{
		if(num%3==0)
		{
			OLED_DrawPoint(num,OUTER_FRAME_Y_1,1);
			OLED_DrawPoint(num,OUTER_FRAME_Y_2,1);
	
			OLED_DrawPoint(num,OUTER_FRAME_Y_3,1);
			OLED_DrawPoint(num,OUTER_FRAME_Y_4,1);
		}
	}
	for(num=0;num<64;num++)
	{
		if(num%3==0)
		{
			OLED_DrawPoint(OUTER_FRAME_X_1,num,1);
			OLED_DrawPoint(OUTER_FRAME_X_2,num,1);
		}
	}
}

/*
信号强度：
一共4个信号强度：
*/

//强度的动态图标  Strength表示信号强度 共有四档信号强度
//Strength :表示信号强值(4)   x：图标起始位置(3) y:坐标的位置(2)

void  GUI_4GSignalStrengthDynamic(u8 Strength,u8 x,u8 y)
{
	u8 num=0;
	GUI_4GSignalStrengthChar();
	if(Strength==0)
	{
		OLED_ShowChineseString(x,y,1,CHARACTER_ICON_SIZE,1 ,(int)ChCh_4G_NoSignalIcon);

	}
	if(Strength>=1)
	{
		for(num=y+9;num<y+12;num++)
		{
			OLED_DrawPoint(x+1,num,1);//3
		}
	}
	if(Strength>=2)
	{
		for(num=y+6;num<y+12;num++)
		{
			OLED_DrawPoint(x+3,num,1);//5
		}
	}
	if(Strength>=3)
	{
		for(num=y+4;num<y+12;num++)
		{
			OLED_DrawPoint(x+5,num,1);//7
		}
	}
	if(Strength>=4)
	{
		for(num=y+2;num<y+12;num++)
		{
			OLED_DrawPoint(x+7,num,1);//9
		}
	}
	if(Strength>=5)
	{
		for(num=y;num<y+12;num++)
		{
			OLED_DrawPoint(x+9,num,1);//9
		}
	}
}
//画长度12一个像素点的竖线 x坐标的位置  //图标间隔竖线显示  12的字 +2上下横线+1的预留空间（上）=15
static void GUI_VerticalLine(u8 x)
{
	u8 num=0;
	for(num=0;num<15;num++) 
	{
		if(num%2==0)
		{
			OLED_DrawPoint(x,num,1);
			OLED_DrawPoint(x+1,num,1);
		}
	}
}
	
//4g信号强度的静态显示
void  GUI_4GSignalStrengthChar(void)
{
	GUI_VerticalLine(X_SignalStrengthCahrEnd);
	OLED_ShowChineseString(X_SignalStrengthCahrStart,Y_START_HEAD,ChCh_4GSignalNUM,CHARACTER_ICON_SIZE,1 ,(int)ChCh_4G_Buffer);
}


//蓝牙的连接状态
void GUI_BleWorkStatus(unsigned char   BleStatus)
{
	switch(BleStatus)
	{
		case eGUI_BleNoConnection: ////没有连接
			OLED_ShowChineseChar(BleWorkStatusStart,Y_START_HEAD,0,CHARACTER_ICON_SIZE,1 ,(int )ChCh_BleIconStatus);
			OLED_ShowChineseString(BleWorkStatusCahrStart,Y_START_HEAD,ChCh_BleNoConnectedNUM,CHARACTER_ICON_SIZE,1 ,(int)ChCh_BleNoConnected);
			GUI_VerticalLine(BleWorkStatusEnd);
		break;
		case eGUI_BleConnected:////已经连接
			OLED_ShowChineseChar(BleWorkStatusStart,Y_START_HEAD,0,CHARACTER_ICON_SIZE,1 ,(int )ChCh_BleIconStatus[1]);
			OLED_ShowChineseString(BleWorkStatusCahrStart,Y_START_HEAD,ChCh_BleConnectedNUM,CHARACTER_ICON_SIZE,1 ,(int)ChCh_BleConnected);
			GUI_VerticalLine(BleWorkStatusEnd);
		break;
		default: break;
	}
}



/*
下边框：相关功能定义
*/
#define		X_VerticalLineGap 14		//s竖线的前后间隙

#define		X_UnderBorderStart  0   				//下边框图标显示X坐标的开始位置
#define		Y_UnderBorderStart  (OUTER_FRAME_Y_3)	//下边框图标显示Y坐标的开始位置

//设备模式切换显示位置 
#define		X_WorkModeStart		14
#define		Y_WorkModeStart		(Y_UnderBorderStart+2)

#define		X_WorkModeVerticalLineStart		(X_WorkModeStart+X_VerticalLineGap+ChCh_ModeSwitchNUM*12)
#define		X_WorkModeVerticalLineEnd		(X_WorkModeVerticalLineStart+X_VerticalLineGap)
//设备工作状态显示位置

#define		X_EquipmentWorkStatusStart		X_WorkModeVerticalLineEnd
#define		Y_EquipmentWorkStatusStart		(Y_UnderBorderStart+2)

#define		X_EquipmentWorkStatusVerticalLineStart		(X_EquipmentWorkStatusStart+X_VerticalLineGap+3*12) //设备状态的显示开始位置
#define		X_EquipmentWorkStatusVerticalLineEnd		(X_WorkModeVerticalLineStart+X_VerticalLineGap)           //设备状态的显示结束位置

//下边框图标隔开的竖线
static void GUI_UnderBorderVerticalLine(u8 x)
{
	u8 y=0;
	for(y=OUTER_FRAME_Y_4-14;y<OUTER_FRAME_Y_4;y++) 
	{
		if(y%2==0)
		{
			OLED_DrawPoint(x,y,1);
			OLED_DrawPoint(x+1,y,1);
		}
	}
}
//设备模式切换
void GUI_WorkMode(eDeviceModeType WorkMode)
{
	GUI_UnderBorderVerticalLine(X_WorkModeVerticalLineStart);
	switch(WorkMode)
	{
		case eDEV_MODE_BASE_STATION:
//			OLED_ShowChineseString(X_WorkModeStart,Y_UnderBorderStart,ChCh_EquipmentWorkStatusIconNum,12,1 ,(int)ChCh_EquipmentWorkStatusIcon);
			OLED_ShowChineseString(X_WorkModeStart,Y_WorkModeStart,ChCh_BaseStationModeNUM,CHARACTER_ICON_SIZE,1 ,(int)ChCh_BaseStationMode);
		break;
		case eDEV_MODE_CANE:
			OLED_ShowChineseString(X_WorkModeStart,Y_WorkModeStart,ChCh_HandheldModeNUM,CHARACTER_ICON_SIZE,1 ,(int)ChCh_HandheldMode);
		break;
//		case eGUI_ModeSwitch:
//			OLED_ShowChineseString(X_WorkModeStart,Y_WorkModeStart,ChCh_ModeSwitchNUM,CHARACTER_ICON_SIZE,1 ,(int)ChCh_ModeSwitch);
//		break;
		default: break;
	}
}

//设备工作状态
void GUI_EquipmentWorkStatus(eEquipmentWorkStatus EquipmentWorkStatus)
{
#if 0//有图标
	OLED_ShowChineseString(X_EquipmentWorkStatusStart,Y_WorkModeStart,ChCh_EquipmentWorkStatusIconNum,CHARACTER_ICON_SIZE,1 ,(int)ChCh_EquipmentWorkStatusIcon);
	switch(EquipmentWorkStatus)
	{
		case eEquipmentWorkStatussY: //正常工作
			OLED_ShowChineseString(X_EquipmentWorkStatusStart,Y_WorkModeStart,ChCh_EquipmentWorkStatusYNum,CHARACTER_ICON_SIZE,1 ,(int)ChCh_EquipmentWorkStatusY);
		break;
		
		case eEquipmentWorkStatussN: //初始化中
			OLED_ShowChineseString(X_EquipmentWorkStatusStart,Y_WorkModeStart,ChCh_EquipmentWorkStatusNNum,CHARACTER_ICON_SIZE,1 ,(int)ChCh_EquipmentWorkStatusN);
		break;
		default: break;
	}
#endif
	
	switch(EquipmentWorkStatus)
	{
		case eEquipmentWorkStatussY: //正常工作
			OLED_ShowChineseString(X_EquipmentWorkStatusStart,Y_WorkModeStart,ChCh_EquipmentWorkStatusYNum,CHARACTER_ICON_SIZE,1 ,(int)ChCh_EquipmentWorkStatusY);
		break;
		
		case eEquipmentWorkStatussN: //初始化中
			OLED_ShowChineseString(X_EquipmentWorkStatusStart-4,Y_WorkModeStart,ChCh_EquipmentWorkStatusNNum,CHARACTER_ICON_SIZE,1 ,(int)ChCh_EquipmentWorkStatusN);
		break;
		default: break;
	}
}
///*
//显示RTK的状态
//*/ 
//#include <string.h>
//#include <stdio.h>
//#define CUI_RTKString  "RTK Status : "
//void CUI_RTKStatus(u8 x,u8 y,stRtkStatus status)
//{
//	u8 len =0;
//	len=strlen(CUI_RTKString);
//	OLED_ShowString(x,y,(u8 *)CUI_RTKString,12);
//	x=x+len*6;
//	
//	switch(gRtkStatus.bit.gpgga_status)
//	{
//		case eGpggaStatus1:
//			OLED_ShowChar(x,y,'1',12,1);//显示ASCII字符
//			break;
//		case eGpggaStatus4:
//			OLED_ShowChar(x,y,'4',12,1);//显示ASCII字符
//			break;
//		case eGpggaStatus7:
//			OLED_ShowChar(x,y,'7',12,1);//显示ASCII字符
//			break;
//		default: 
//			OLED_ShowChar(x,y,'0',12,1);//显示ASCII字符
//			break;
//	}
//}
///*
//显示电台通道号
//*/
//#include "HX_DU1018D.h"
//#define CUI_RadioChannelString  "Radio Channel : "
//void CUI_RadioChannel(u8 x,u8 y,stDu1018dStatus Du1018dStatus)
//{
//	u8 len =0;
//	u8 Channel =0;
//	len=strlen(CUI_RadioChannelString);
//	OLED_ShowString(x,y,(u8 *)CUI_RadioChannelString,12);
//	x=x+len*6;
//	
//	Channel=Du1018dStatus.bit.Channel+'0';
//	OLED_ShowChar(x,y,Channel,12,1);//显示ASCII字符
//}
///*
//见面的数据状态刷新
//*/
//#include "me3630.h"
//#include "bluetooth.h"
//#include "MySysStatus.h"
//void GUI_CtrDataRefresh(stGUICtrData  *GUICtrData)
//{
//	u8 NetworkSignalStrength=0;//存放4G的信号强度
//	//4G信号强度读取
//	/*
//		0     –    <0.01%   
//		1     –    0.01% --- 0.1%   
//		2     –    0.1% --- 0.5%   
//		3     –    0.5% --- 1.0%   
//		4     –    1.0% --- 2.0%   
//		5     –    2.0% --- 4.0%   
//		6     –    4.0% --- 8.0%   
//		7     –    多余 8.0% 
//		99    无网络
//	*/
//	Me3630GetSignal((char*)&NetworkSignalStrength,&Me3630Status ); //获取4G的信号强度
//	if(NetworkSignalStrength==99)
//	{
//		GUICtrData->NetworkSignalStrength=0;
//	}else{
//		GUICtrData->NetworkSignalStrength=NetworkSignalStrength/20+1;
//	}

//	//蓝牙的链接状态
//	GUICtrData->BleConnection=BL_CONNECTION_STATUS();
//	
//	//电池电量  0-9 
//	/*
//		电量显示的代码
//	*/
//	//工作模式
//	GUICtrData->WorkMode=gMySysStatus.bit.WorkMode;
//	//工作状态
//	
//	

//}
//设(0) 备(1) 初(2) 始(3) 化(4) 中(5)
//开机设备初始化
//设备初始化
#define  ChCh_DeviceInitializationNum 9
const unsigned char ChCh_DeviceInitialization[ChCh_DeviceInitializationNum][24]= 
{
	{0x08,0x00,0x88,0x00,0x4F,0xE0,0x00,0x40,0x0A,0x10,0xF3,0x10,0x82,0xA0,0x82,0x40,0xF2,0xA0,0x0B,0x10,0x08,0x10,0x00,0x00},//"设",0                                                                              
	{0x04,0x00,0x24,0x00,0x4B,0xF0,0xEA,0xA0,0x52,0xA0,0x53,0xE0,0x52,0xA0,0x6A,0xA0,0x4B,0xF0,0x04,0x00,0x04,0x00,0x00,0x00},//"备",1                                                                              
	{0x21,0x00,0xA2,0x00,0x6F,0xF0,0x32,0x00,0x05,0x10,0x40,0x60,0x7F,0x80,0x40,0x00,0x40,0x10,0x40,0x10,0x7F,0xE0,0x00,0x00},//"初",2                                                                              
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	{0x00,0x00,0x00,0x00,0x03,0x00,0x04,0x80,0x04,0x80,0x03,0x00,0x00,0x00,0x00,0x00,0x00,0x00,0x00,0x00,0x00,0x00,0x00,0x00},//"。",8
};
const unsigned char data[]={
	 0x70,0x20,0x10,0x40,0x11,0x90,0x1E,0x10,0xF3,0x20,0x12,0xA0,0x12,0x40,0x92,0xA0,
0x53,0x20,0x10,0x10,0x10,0x10,0x00,0x00//"发",0

};
#define  BtStartStrNum       8
unsigned char BtStartStrings[BtStartStrNum][24]= 
{
		0x20,0x40,0x3F,0xC0,0x24,0x40,0x24,0x40,0x1B,0x80,0x00,0x00,//H;"B",0 
		0x00,0x00,0x03,0x80,0x04,0x40,0x04,0x40,0x03,0x80,0x00,0x00,//H;"o",1 
		0x00,0x00,0x03,0x80,0x04,0x40,0x04,0x40,0x03,0x80,0x00,0x00,//H;"o",2 
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	{0x00,0x00,0x00,0x00,0x03,0x00,0x04,0x80,0x04,0x80,0x03,0x00,0x00,0x00,0x00,0x00,0x00,0x00,0x00,0x00,0x00,0x00,0x00,0x00},//"。",8
};
const unsigned char EndChar[]={0x00,0x00,0x00,0x00,0x03,0x00,0x04,0x80,0x04,0x80,0x03,0x00,0x00,0x00,0x00,0x00,0x00,0x00,0x00,0x00,0x00,0x00,0x00,0x00};//"。",6
#define UpdatePrepareNum   8
unsigned char UpdatePrepare[BtStartStrNum][24]=
{ 
	0x04,0x00,0x44,0x10,0x44,0x60,0x7F,0x80,0x84,0x00,0x84,0x00,0x04,0x00,0x04,0x00,0xFF,0xF0,0x04,0x00,0x04,0x00,0x00,0x00,//H;"升",2 
  0x19,0x20,0x2B,0x20,0xCD,0x40,0x11,0x50,0x40,0x60,0x7F,0x80,0x41,0x10,0x40,0xA0,0x4C,0x40,0x74,0xA0,0x07,0x10,0x00,0x00,//H;"级",3
	0x20,0x20,0x10,0x40,0x04,0x80,0x08,0x00,0x3F,0xF0,0xE4,0x90,0x24,0x90,0xBF,0xF0,0x64,0x90,0x24,0x90,0x20,0x10,0x00,0x00,//H;"准",0 
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	{0x00,0x00,0x00,0x00,0x03,0x00,0x04,0x80,0x04,0x80,0x03,0x00,0x00,0x00,0x00,0x00,0x00,0x00,0x00,0x00,0x00,0x00,0x00,0x00},//"。",8
};
#define UpdateNum   6
unsigned char Update[UpdateNum][24]=
{
	0x04,0x00,0x44,0x10,0x44,0x60,0x7F,0x80,0x84,0x00,0x84,0x00,0x04,0x00,0x04,0x00,0xFF,0xF0,0x04,0x00,0x04,0x00,0x00,0x00,//H;"升",2 
  0x19,0x20,0x2B,0x20,0xCD,0x40,0x11,0x50,0x40,0x60,0x7F,0x80,0x41,0x10,0x40,0xA0,0x4C,0x40,0x74,0xA0,0x07,0x10,0x00,0x00,//H;"级",3
	{0x00,0x00,0x1F,0x80,0x11,0x00,0x11,0x00,0x11,0x00,0xFF,0xF0,0x11,0x00,0x11,0x00,0x11,0x00,0x1F,0x80,0x00,0x00,0x00,0x00},//"中",5
	{0x00,0x00,0x00,0x00,0x03,0x00,0x04,0x80,0x04,0x80,0x03,0x00,0x00,0x00,0x00,0x00,0x00,0x00,0x00,0x00,0x00,0x00,0x00,0x00},//"。",6
	{0x00,0x00,0x00,0x00,0x03,0x00,0x04,0x80,0x04,0x80,0x03,0x00,0x00,0x00,0x00,0x00,0x00,0x00,0x00,0x00,0x00,0x00,0x00,0x00},//"。",7
	{0x00,0x00,0x00,0x00,0x03,0x00,0x04,0x80,0x04,0x80,0x03,0x00,0x00,0x00,0x00,0x00,0x00,0x00,0x00,0x00,0x00,0x00,0x00,0x00},//"。",8
};
#define UpdateWriteOKNum   7
unsigned char UpdateWriteOK[UpdateWriteOKNum][24]=
{
	0xC0,0x40,0x86,0x40,0xFA,0x40,0x92,0x40,0x92,0x40,0x92,0x40,0x92,0x50,0x92,0x50,0x92,0x10,0x93,0xE0,0xC0,0x00,0x00,0x00,//H;"写",0 
	0x00,0x10,0x00,0x20,0x80,0x40,0x81,0x80,0x4E,0x00,0x30,0x00,0x0E,0x00,0x01,0x80,0x00,0x40,0x00,0x20,0x00,0x10,0x00,0x00,//H;"入",1
	0x61,0x10,0x41,0x10,0x49,0x20,0x49,0xC0,0x49,0x00,0xC9,0x00,0x49,0x00,0x49,0xE0,0x49,0x10,0x41,0x10,0x61,0x30,0x00,0x00,//H;"完",2
	0x00,0x10,0x3F,0xE0,0x24,0x00,0x24,0x40,0x27,0xD0,0x20,0x20,0xFF,0x40,0x20,0x80,0xA1,0x40,0x66,0x20,0x20,0xF0,0x00,0x00,//H;"成",3
	{0x00,0x00,0x00,0x00,0x03,0x00,0x04,0x80,0x04,0x80,0x03,0x00,0x00,0x00,0x00,0x00,0x00,0x00,0x00,0x00,0x00,0x00,0x00,0x00},//"。",6
	{0x00,0x00,0x00,0x00,0x03,0x00,0x04,0x80,0x04,0x80,0x03,0x00,0x00,0x00,0x00,0x00,0x00,0x00,0x00,0x00,0x00,0x00,0x00,0x00},//"。",7
	{0x00,0x00,0x00,0x00,0x03,0x00,0x04,0x80,0x04,0x80,0x03,0x00,0x00,0x00,0x00,0x00,0x00,0x00,0x00,0x00,0x00,0x00,0x00,0x00},//"。",8
};
#define UpdateJumpNum   7
unsigned char UpdateJump[UpdateJumpNum][24]=
{
	0x11,0x00,0x16,0x00,0xFF,0xF0,0x14,0x00,0x22,0x10,0x24,0x10,0xAB,0xA0,0x60,0x40,0x2B,0xA0,0x24,0x10,0x22,0x10,0x00,0x00,//H;"校",0 
	0x5E,0x40,0x42,0x50,0x7E,0x90,0x03,0xE0,0x08,0x90,0x14,0x70,0x25,0x10,0xC4,0xD0,0x24,0x30,0x15,0xD0,0x08,0x10,0x00,0x00,//H;"验",1 
	0x48,0x80,0x4B,0x00,0x7F,0xF0,0x8A,0x00,0x01,0x10,0xF4,0x90,0x94,0x90,0x97,0xF0,0x94,0x90,0xF4,0x90,0x00,0x10,0x00,0x00,//H;"程",2 
	0x00,0x10,0x7F,0xE0,0x41,0x00,0x51,0x00,0x55,0x00,0x55,0x10,0xD3,0xF0,0x55,0x00,0x59,0x00,0x51,0x40,0x41,0x80,0x00,0x00,//H;"序",3 
	{0x00,0x00,0x00,0x00,0x03,0x00,0x04,0x80,0x04,0x80,0x03,0x00,0x00,0x00,0x00,0x00,0x00,0x00,0x00,0x00,0x00,0x00,0x00,0x00},//"。",6
	{0x00,0x00,0x00,0x00,0x03,0x00,0x04,0x80,0x04,0x80,0x03,0x00,0x00,0x00,0x00,0x00,0x00,0x00,0x00,0x00,0x00,0x00,0x00,0x00},//"。",7
	{0x00,0x00,0x00,0x00,0x03,0x00,0x04,0x80,0x04,0x80,0x03,0x00,0x00,0x00,0x00,0x00,0x00,0x00,0x00,0x00,0x00,0x00,0x00,0x00},//"。",8
};
#define UpdateSucceedNum   7
unsigned char UpdateSucceed[UpdateSucceedNum][24]=
{
	0x04,0x00,0x44,0x10,0x44,0x60,0x7F,0x80,0x84,0x00,0x84,0x00,0x04,0x00,0x04,0x00,0xFF,0xF0,0x04,0x00,0x04,0x00,0x00,0x00,//"升",0
	0x19,0x20,0x2B,0x20,0xCD,0x40,0x11,0x50,0x40,0x60,0x7F,0x80,0x41,0x10,0x40,0xA0,0x4C,0x40,0x74,0xA0,0x07,0x10,0x00,0x00,//"级",1
	0x00,0x10,0x3F,0xE0,0x24,0x00,0x24,0x40,0x27,0xD0,0x20,0x20,0xFF,0x40,0x20,0x80,0xA1,0x40,0x66,0x20,0x20,0xF0,0x00,0x00,//"成",2
	0x20,0x40,0x20,0x40,0x3F,0x80,0x20,0x90,0x20,0xA0,0x10,0xC0,0xFF,0x00,0x10,0x00,0x10,0x10,0x10,0x10,0x1F,0xE0,0x00,0x00,//"功",3
	{0x00,0x00,0x00,0x00,0x03,0x00,0x04,0x80,0x04,0x80,0x03,0x00,0x00,0x00,0x00,0x00,0x00,0x00,0x00,0x00,0x00,0x00,0x00,0x00},//"。",6
	{0x00,0x00,0x00,0x00,0x03,0x00,0x04,0x80,0x04,0x80,0x03,0x00,0x00,0x00,0x00,0x00,0x00,0x00,0x00,0x00,0x00,0x00,0x00,0x00},//"。",7
	{0x00,0x00,0x00,0x00,0x03,0x00,0x04,0x80,0x04,0x80,0x03,0x00,0x00,0x00,0x00,0x00,0x00,0x00,0x00,0x00,0x00,0x00,0x00,0x00},//"。",8
};
#define FactorySetNum   9
unsigned char FactorySet[FactorySetNum][24]=
{
	0x22,0X80,0XCA,0X80,0X4A,0XC0,0X6A,0XA0,0X4A,0X80,0X3E,0X90,0XCA,0X90,0X4B,0XF,0x6A,0X80,0X4A,0X80,0X42,0X80,0X00,0X00,//H;"等",0 
	0x12,0X00,0X24,0X00,0X4F,0XF0,0X90,0X00,0X0A,0X00,0X2A,0X80,0X2A,0X50,0XFA,0X10,0x2F,0XF0,0X2A,0X00,0X0A,0X00,0X00,0X00,//H;"待",1
	0x01,0xE0,0x78,0x20,0x08,0x20,0x08,0x20,0x08,0x20,0xFF,0xE0,0x08,0x20,0x08,0x20,0x08,0x20,0x78,0x20,0x01,0xF0,0x00,0x00,//H;"出",0 
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	{0x00,0x00,0x00,0x00,0x03,0x00,0x04,0x80,0x04,0x80,0x03,0x00,0x00,0x00,0x00,0x00,0x00,0x00,0x00,0x00,0x00,0x00,0x00,0x00},//"。",8
};
#define FactorySetOKNum   6
unsigned char FactorySetOK[FactorySetOKNum][24]=
{ 
	0x01,0xE0,0x78,0x20,0x08,0x20,0x08,0x20,0x08,0x20,0xFF,0xE0,0x08,0x20,0x08,0x20,0x08,0x20,0x78,0x20,0x01,0xF0,0x00,0x00,//H;"出",0 
	0x00,0x10,0x7F,0xE0,0x40,0x00,0x40,0x00,0x40,0x00,0x40,0x00,0x40,0x00,0x40,0x00,0x40,0x00,0x40,0x00,0x40,0x00,0x00,0x00,//H;"厂",1 
	0x08,0x00,0x88,0x00,0x4F,0xE0,0x00,0x40,0x0A,0x10,0xF3,0x10,0x82,0xA0,0x82,0x40,0xF2,0xA0,0x0B,0x10,0x08,0x10,0x00,0x00,//H;"设",2 
	0x08,0x10,0xE8,0x10,0xAB,0xF0,0xAA,0x10,0xEA,0x10,0xBE,0x70,0xEA,0x10,0xAA,0x10,0xAB,0xF0,0xE8,0x10,0x08,0x10,0x00,0x00,//H;"置",3 
	0x61,0x10,0x41,0x10,0x49,0x20,0x49,0xC0,0x49,0x00,0xC9,0x00,0x49,0x00,0x49,0xE0,0x49,0x10,0x41,0x10,0x61,0x30,0x00,0x00,//H;"完",0 
	0x00,0x10,0x3F,0xE0,0x24,0x00,0x24,0x40,0x27,0xD0,0x20,0x20,0xFF,0x40,0x20,0x80,0xA1,0x40,0x66,0x20,0x20,0xF0,0x00,0x00,//H;"成",1
}; 
extern u8 OLED_GRAM[128][8] ;	 
#define BOOT_INIT_LED_REFRESH_START    (BtStartStrNum-3)
/*
开机显示状态
*/
void  GUI_DeviceBootInit(u8 x,u8 y)
{ 
		static  char temp =0 ; 
		u8 i,n;  
		for(i=0;i<8;i++)for(n=0;n<128;n++)OLED_GRAM[n][i]=0X00;  
		GUI_Wireframe(); 
		GUI_BleWorkStatus(gBleConnectStatus); 	
		GUI_BatteryPower(8); 
		GUI_WorkMode(gOledDeviceMode); 
		GUI_4GSignalStrengthDynamic(0,2,2); 
		GUI_EquipmentWorkStatus(1);//工作状态 
		if(temp==0)
		{
			memcpy(BtStartStrings[BOOT_INIT_LED_REFRESH_START],EndChar,12);
			memset(BtStartStrings[BOOT_INIT_LED_REFRESH_START+1],0,12);
			memset(BtStartStrings[BOOT_INIT_LED_REFRESH_START+2],0,12);
		}
		else if(temp==1)
		{
			memcpy(BtStartStrings[BOOT_INIT_LED_REFRESH_START],EndChar,12);
			memcpy(BtStartStrings[BOOT_INIT_LED_REFRESH_START+1],EndChar,12);
			memset(BtStartStrings[BOOT_INIT_LED_REFRESH_START+2],0,12);
		}
		else if(temp==2)
		{
			memcpy(BtStartStrings[BOOT_INIT_LED_REFRESH_START],EndChar,12);
			memcpy(BtStartStrings[BOOT_INIT_LED_REFRESH_START+1],EndChar,12);
			memcpy(BtStartStrings[BOOT_INIT_LED_REFRESH_START+2],EndChar,12);
		}
		temp++;
		if(temp>2)
			temp=0;
		
		OLED_ShowChineseString(x,y,BtStartStrNum,CHARACTER_ICON_SIZE,1 ,(int)BtStartStrings);
		//OLED_ShowChineseChar(x+20,y+20,0,CHARACTER_ICON_SIZE,1,(int)data);
		OLED_Refresh_Gram();//更新显示到OLED		
		delay_ms(200);
}
#define UPDATTE_PRE_LED_REFRESH_START    (UpdatePrepareNum-3)
void  GUI_DeviceUpdatePrepare(u8 x,u8 y)
{
		static  char temp =0 ; 
		u8 i,n;  
		for(i=0;i<8;i++)for(n=0;n<128;n++)OLED_GRAM[n][i]=0X00;  
		GUI_Wireframe(); 
		GUI_BleWorkStatus(gBleConnectStatus); 
		GUI_BatteryPower(8); 
		GUI_WorkMode(gOledDeviceMode); 	
		GUI_4GSignalStrengthDynamic(0,2,2); 
		GUI_EquipmentWorkStatus(1);//工作状态 
		if(temp==0)
		{
			memcpy(UpdatePrepare[UPDATTE_PRE_LED_REFRESH_START],EndChar,12);
			memset(UpdatePrepare[UPDATTE_PRE_LED_REFRESH_START+1],0,12);
			memset(UpdatePrepare[UPDATTE_PRE_LED_REFRESH_START+2],0,12);
		}
		else if(temp==1)
		{
			memcpy(UpdatePrepare[UPDATTE_PRE_LED_REFRESH_START],EndChar,12);
			memcpy(UpdatePrepare[UPDATTE_PRE_LED_REFRESH_START+1],EndChar,12);
			memset(UpdatePrepare[UPDATTE_PRE_LED_REFRESH_START+2],0,12);
		}
		else if(temp==2)
		{
			memcpy(UpdatePrepare[UPDATTE_PRE_LED_REFRESH_START],EndChar,12);
			memcpy(UpdatePrepare[UPDATTE_PRE_LED_REFRESH_START+1],EndChar,12);
			memcpy(UpdatePrepare[UPDATTE_PRE_LED_REFRESH_START+2],EndChar,12);
		}
		temp++;
		if(temp>2)
			temp=0;
		
		OLED_ShowChineseString(x,y,UpdatePrepareNum,CHARACTER_ICON_SIZE,1 ,(int)UpdatePrepare);
		//OLED_ShowChineseChar(x+20,y+20,0,CHARACTER_ICON_SIZE,1,(int)data);
		OLED_Refresh_Gram();//更新显示到OLED		
		delay_ms(200);
}
#define UPDATTE_LED_REFRESH_START    (UpdateNum-3)
void  GUI_DeviceUpdate(u8 x,u8 y)
{
		static  char temp =0 ; 
		u8 i,n;  
		for(i=0;i<8;i++)for(n=0;n<128;n++)OLED_GRAM[n][i]=0X00;  
		GUI_Wireframe(); 	
		GUI_BleWorkStatus(gBleConnectStatus) 	;
		GUI_BatteryPower(8); 	
		GUI_WorkMode(gOledDeviceMode); 
		GUI_4GSignalStrengthDynamic(0,2,2); 
		GUI_EquipmentWorkStatus(1);//工作状态 
		if(temp==0)
		{
			memcpy(Update[UPDATTE_LED_REFRESH_START],EndChar,12);
			memset(Update[UPDATTE_LED_REFRESH_START+1],0,12);
			memset(Update[UPDATTE_LED_REFRESH_START+2],0,12);
		}
		else if(temp==1)
		{
			memcpy(Update[UPDATTE_LED_REFRESH_START],EndChar,12);
			memcpy(Update[UPDATTE_LED_REFRESH_START+1],EndChar,12);
			memset(Update[UPDATTE_LED_REFRESH_START+2],0,12);
		}
		else if(temp==2)
		{
			memcpy(Update[UPDATTE_LED_REFRESH_START],EndChar,12);
			memcpy(Update[UPDATTE_LED_REFRESH_START+1],EndChar,12);
			memcpy(Update[UPDATTE_LED_REFRESH_START+2],EndChar,12);
		}
		temp++;
		if(temp>2)
			temp=0;
		
		OLED_ShowChineseString(x,y,UpdateNum,CHARACTER_ICON_SIZE,1 ,(int)Update);
		//OLED_ShowChineseChar(x+20,y+20,0,CHARACTER_ICON_SIZE,1,(int)data);
		OLED_Refresh_Gram();//更新显示到OLED		
		delay_ms(200);
}

void  GUI_DeviceWriteAppOk(u8 x,u8 y)
{
		static  char temp =0 ; 
		u8 i,n;  
		for(i=0;i<8;i++)for(n=0;n<128;n++)OLED_GRAM[n][i]=0X00;  
		GUI_Wireframe(); 	
		GUI_BleWorkStatus(gBleConnectStatus); 
		GUI_BatteryPower(8); 
		GUI_WorkMode(gOledDeviceMode); 	
		GUI_4GSignalStrengthDynamic(0,2,2); 	
		GUI_EquipmentWorkStatus(1);//工作状态 
		
		OLED_ShowChineseString(x,y,UpdateWriteOKNum,CHARACTER_ICON_SIZE,1 ,(int)UpdateWriteOK);
		//OLED_ShowChineseChar(x+20,y+20,0,CHARACTER_ICON_SIZE,1,(int)data);
		OLED_Refresh_Gram();//更新显示到OLED		
		delay_ms(500);  
		OLED_ShowChineseString(x,y,UpdateJumpNum,CHARACTER_ICON_SIZE,1 ,(int)UpdateJump);
		//OLED_ShowChineseChar(x+20,y+20,0,CHARACTER_ICON_SIZE,1,(int)data);
		OLED_Refresh_Gram();//更新显示到OLED		
		delay_ms(1000);  
}
void  GUI_DeviceUpdateAppOk(u8 x,u8 y)
{ 
		u8 i,n;  
		for(i=0;i<8;i++)for(n=0;n<128;n++)OLED_GRAM[n][i]=0X00;  
		GUI_Wireframe(); 	
		GUI_BleWorkStatus(gBleConnectStatus); 
		GUI_BatteryPower(8); 
		GUI_WorkMode(gOledDeviceMode); 	
		GUI_4GSignalStrengthDynamic(0,2,2); 	
		GUI_EquipmentWorkStatus(1);//工作状态  
		OLED_ShowChineseString(x,y,UpdateSucceedNum,CHARACTER_ICON_SIZE,1 ,(int)UpdateSucceed);
		//OLED_ShowChineseChar(x+20,y+20,0,CHARACTER_ICON_SIZE,1,(int)data);
		OLED_Refresh_Gram();//更新显示到OLED		
		delay_ms(1000);  
}
#define FATCTORY_SET_LED_FRESH_START    (FactorySetNum-3)
void  GUI_DeviceFactorySet(u8 x,u8 y)
{
		static  char temp =0; 
		u8 i,n;  
		for(i=0;i<8;i++)for(n=0;n<128;n++)OLED_GRAM[n][i]=0X00;  
		GUI_Wireframe(); 	
		GUI_BleWorkStatus(gBleConnectStatus) 	;
		GUI_BatteryPower(8); 	
		GUI_WorkMode(gOledDeviceMode); 
		GUI_4GSignalStrengthDynamic(0,2,2); 
		GUI_EquipmentWorkStatus(1);//工作状态 
		if(temp==0)
		{
			memcpy(FactorySet[FATCTORY_SET_LED_FRESH_START],EndChar,12);
			memset(FactorySet[FATCTORY_SET_LED_FRESH_START+1],0,12);
			memset(FactorySet[FATCTORY_SET_LED_FRESH_START+2],0,12);
		}
		else if(temp==1)
		{
			memcpy(FactorySet[FATCTORY_SET_LED_FRESH_START],EndChar,12);
			memcpy(FactorySet[FATCTORY_SET_LED_FRESH_START+1],EndChar,12);
			memset(FactorySet[FATCTORY_SET_LED_FRESH_START+2],0,12);
		}
		else if(temp==2)
		{
			memcpy(FactorySet[FATCTORY_SET_LED_FRESH_START],EndChar,12);
			memcpy(FactorySet[FATCTORY_SET_LED_FRESH_START+1],EndChar,12);
			memcpy(FactorySet[FATCTORY_SET_LED_FRESH_START+2],EndChar,12);
		}
		temp++;
		if(temp>2)
			temp=0; 
		OLED_ShowChineseString(x,y,FactorySetNum,CHARACTER_ICON_SIZE,1 ,(int)FactorySet);
		//OLED_ShowChineseChar(x+20,y+20,0,CHARACTER_ICON_SIZE,1,(int)data);
		OLED_Refresh_Gram();//更新显示到OLED		
		delay_ms(200);
}
void  GUI_DeviceFactorySetOK(u8 x,u8 y)
{
		static  char temp =0 ; 
		u8 i,n;  
		for(i=0;i<8;i++)for(n=0;n<128;n++)OLED_GRAM[n][i]=0X00;  
		GUI_Wireframe(); 	
		GUI_BleWorkStatus(gBleConnectStatus); 
		GUI_BatteryPower(8); 
		GUI_WorkMode(gOledDeviceMode); 	
		GUI_4GSignalStrengthDynamic(0,2,2); 	
		GUI_EquipmentWorkStatus(1);//工作状态  
		OLED_ShowChineseString(x,y,FactorySetOKNum,CHARACTER_ICON_SIZE,1 ,(int)FactorySetOK);
		//OLED_ShowChineseChar(x+20,y+20,0,CHARACTER_ICON_SIZE,1,(int)data);
		OLED_Refresh_Gram();//更新显示到OLED		
		delay_ms(1000);  
}



